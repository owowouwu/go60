
/ {
    inputs {
        cirque_split_rh: cirque_split_rh@0 {
            compatible = "zmk,input-split";
            reg = <1>;
            device = <&glidepoint>;
        };
    };
};

/delete-node/ &cirque_split;

