## config/boards/shields/go60_dongle/Kconfig.shield
```kconfig
config SHIELD_MY_KEYBOARD_DONGLE
    def_bool $(shields_list_contains,go60_dongle)
```

## config/west.yml
```yaml
manifest:
  remotes:
    - name: moergo-sc
      url-base: https://github.com/moergo-sc
    - name: janpfischer
      url-base: https://github.com/janpfischer
  projects:
    - name: zmk
      remote: moergo-sc
      revision: main
      import: app/west.yml
    - name: zmk-dongle-screen
      remote: janpfischer
      revision: main
  self:
    path: config
```
